## conf/layer.conf
```bitbake
# We have a conf and classes directory, add to BBPATH
BBPATH .= ":${LAYERDIR}"

# We have recipes-* directories, add to BBFILES
BBFILES += "${LAYERDIR}/recipes-*/*/*.bb \
            ${LAYERDIR}/recipes-*/*/*.bbappend"

BBFILE_COLLECTIONS += "meta-am3352-aki"
BBFILE_PATTERN_meta-am3352-aki = "^${LAYERDIR}/"
BBFILE_PRIORITY_meta-am3352-aki = "6"

LAYERDEPENDS_meta-am3352-aki = "core"
LAYERSERIES_COMPAT_meta-am3352-aki = "kirkstone"
```

## conf/machine/am3352-aki.conf
```bitbake
MACHINEOVERRIDES =. "beaglebone-yocto:"
require conf/machine/beaglebone-yocto.conf

KERNEL_DEVICETREE:am3352-aki ?= "am3352-aki.dtb"

UBOOT_EXTLINUX:am3352-aki ?= "1"
UBOOT_EXTLINUX_FDT:am3352-aki ?= "../am3352-aki.dtb"
UBOOT_EXTLINUX_ROOT:am3352-aki  ?= "root=PARTUUID=${uuid}"
UBOOT_EXTLINUX_BOOT_FILES:am3352-aki  ?= " \
    extlinux.conf;extlinux/extlinux.conf \
    ${KERNEL_IMAGETYPE} \
    ${KERNEL_DEVICETREE} \
"
IMAGE_BOOT_FILES:am3352-aki ?= "${SPL_BINARY} u-boot.${UBOOT_SUFFIX} ${UBOOT_EXTLINUX_BOOT_FILES}"

IMAGE_FSTYPES:append:am3352-aki = " wic.bmap"
```
